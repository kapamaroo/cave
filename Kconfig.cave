## Kconfig.cave
```kconfig
menu "CAVE infrastructure"

config CAVE
        bool "CAVE feature"
        default n

config CAVE_STATS
        bool "CAVE stats"
        default n
	depends on CAVE

config CAVE_SYSCALL_RATELIMIT
        bool "CAVE syscall rate limit"
        default n
        depends on CAVE

config CAVE_SKIP_ARCH_RW
        bool "Skip architecture changes to voltage."
        default n
	depends on CAVE

config CAVE_SYSCALL_CONTEXT
       bool "Set voffset per syscall granularity."
       default n
       depends on CAVE

config CAVE_COMMON_VOLTAGE_DOMAIN
       bool "One voltage domain for all CPUS."
       default y
       depends on CAVE

config CAVE_RAW_VOLTAGE_LOGGING
       bool "Measure voltage from MSR, print to trace_printk()."
       default n
       depends on CAVE_SYSCALL_CONTEXT

endmenu
```

## Kconfig.uniserver
```kconfig
menu "UniServer Platform"

config UNISERVER_CAVE
        bool "CAVE feature"
        default n

config UNISERVER_CAVE_STATS
        bool "CAVE stats"
        default n
	depends on UNISERVER_CAVE

config UNISERVER_CAVE_SYSCALL_RATELIMIT
        bool "CAVE syscall rate limit"
        default n
        depends on UNISERVER_CAVE

config UNISERVER_CAVE_SKIP_MSR
        bool "Skip msr voltage."
        default n
	depends on UNISERVER_CAVE

config UNISERVER_CAVE_SYSCALL_CONTEXT
       bool "Set voffset per syscall granularity."
       default n
       depends on UNISERVER_CAVE

config UNISERVER_CAVE_ONE_VOLTAGE_DOMAIN
       bool "One voltage domain for all CPUS."
       default y
       depends on UNISERVER_CAVE

config UNISERVER_CAVE_MSR_VOLTAGE
       bool "Measure voltage from MSR, print to trace_printk()."
       default n
       depends on UNISERVER_CAVE_SYSCALL_CONTEXT

endmenu
```
